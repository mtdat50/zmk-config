#define CONFIG_WIRELESS
#define ZMK_BASE_LAYER(name, LT, RT, LM, RM, LB, RB, LH, RH)                   \
    ZMK_LAYER(                                                                 \
        name,                                                                  \
                 LT RT                                                         \
                 LM RM                                                         \
                 LB RB                                                         \
        &kp LGUI LH RH &smart_mouse                                            \
    )

#include "zmk-helpers/key-labels/42.h"
#include "base.keymap"
/* #include "physical-layout.dtsi" */
/**/
/* /{ chosen { zmk,physical-layout = &foostan_corne_6col_layout; }; }; */
